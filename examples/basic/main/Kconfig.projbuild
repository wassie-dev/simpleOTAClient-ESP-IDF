## examples/basic/main/Kconfig.projbuild
```kconfig
menu "Example Configuration"

config EXAMPLE_WIFI_SSID
    string "Wi-Fi SSID"
    default "myssid"

config EXAMPLE_WIFI_PASSWORD
    string "Wi-Fi password"
    default "mypassword"

config EXAMPLE_SIMPLEOTA_TOKEN
    string "SimpleOTA project token"
    default "paste-your-project-token"
    help
        Create a project at https://simpleota.com, then copy a project API
        token with the device scope (Project -> API tokens).

config EXAMPLE_IMAGE_BUILD
    int "SimpleOTA build number of this image"
    default 0
    help
        The build number SimpleOTA gives this image, when you know it before
        you build. It is reported only when the image was flashed over USB
        rather than installed by SimpleOTA, so the server does not replace
        it with its current release. 0 reports build 0.

endmenu
```

## examples/polling/main/Kconfig.projbuild
```kconfig
menu "Example Configuration"

config EXAMPLE_WIFI_SSID
    string "Wi-Fi SSID"
    default "myssid"

config EXAMPLE_WIFI_PASSWORD
    string "Wi-Fi password"
    default "mypassword"

config EXAMPLE_SIMPLEOTA_TOKEN
    string "SimpleOTA project token"
    default "paste-your-project-token"
    help
        Create a project at https://simpleota.com, then copy a project API
        token with the device scope (Project -> API tokens).

endmenu
```

## simpleota/Kconfig
```kconfig
menu "SimpleOTA"

config SIMPLEOTA_TASK_STACK_SIZE
    int "OTA task stack size (bytes)"
    default 12288
    help
        The managed task performs TLS handshakes (esp_http_client with the
        certificate bundle) and response parsing on its own stack. The
        short-lived task that posts the status for
        simpleota_reboot_for_update() uses the same size. 8192 usually
        works; the 12288 default leaves headroom on all targets.

config SIMPLEOTA_TASK_PRIORITY
    int "OTA task priority"
    range 1 20
    default 5
    help
        Priority of the managed OTA task. Keep it below the Wi-Fi and lwIP
        tasks (the default 5 is) so networking is never starved.

config SIMPLEOTA_HTTP_TIMEOUT_MS
    int "HTTP timeout (ms)"
    default 15000
    help
        Socket timeout for the check, status, and download requests. During
        a download this doubles as the stall detector: a read that makes no
        progress for this long fails the update with reason
        "download_stalled". The trial watchdog's margin grows with it, so a
        trial can always finish its current request and roll back first.

config SIMPLEOTA_HTTP_TX_BUFFER
    int "HTTP client TX buffer (bytes)"
    default 2048
    help
        Must fit the entire request line and headers. Pre-signed download
        URLs are routinely 500-1500+ characters, which overflows the
        esp_http_client default of 512 bytes.

config SIMPLEOTA_DOWNLOAD_CHUNK
    int "Download/flash chunk size (bytes)"
    range 512 16384
    default 4096
    help
        Heap-allocated buffer used to stream the firmware image from the
        HTTP client into the OTA partition while hashing and verifying.

config SIMPLEOTA_SOFTWARE_ROLLBACK
    bool "Roll back failed updates without bootloader rollback"
    default y
    depends on !BOOTLOADER_APP_ROLLBACK_ENABLE
    help
        Without CONFIG_BOOTLOADER_APP_ROLLBACK_ENABLE, a new image still
        runs as a trial: if it is not confirmed within the confirm timeout,
        hangs, crashes or resets by a watchdog first, the component switches
        back to the previous image itself. A crash before simpleota_init()
        runs is not caught, which bootloader rollback does catch, so enable
        that on new devices. Disable this to accept a new image on its first
        boot, as releases before 0.3 did.

config SIMPLEOTA_DISABLE_TRIAL_WATCHDOG
    bool "Leave the chip watchdog alone during a trial"
    default n
    depends on BOOTLOADER_APP_ROLLBACK_ENABLE || SIMPLEOTA_SOFTWARE_ROLLBACK
    help
        On a trial boot the component starts the chip's RTC or LP watchdog
        for the confirm timeout plus a margin, so a hang that stops the
        confirm timer still resets the chip and the previous image comes
        back. Enable this to leave the watchdog out. The confirm timer still
        runs, and a crash still rolls back.

endmenu
```
